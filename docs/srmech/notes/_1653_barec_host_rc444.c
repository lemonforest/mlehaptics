/*
 * _1653_barec_host_rc444.c — gh #1653 / ADR-0003 BARE-C HOST proof (rc444)
 *
 * THE CLAIM UNDER TEST (gh #1653 acceptance criterion):
 *   "A bare-C host (no Python present) can load the shipped catalog and run a
 *    declared chain end-to-end. Proven from an actual bare-C test, per
 *    ADR-0003, NOT from the ctypes path."
 *
 * This is a MEASURING INSTRUMENT, not a shipped test. It lives under
 * docs/srmech/notes/ and links c/build/libsrmech.a. There is NO Python in the
 * process: the descriptor TOML is read from disk by this host, parsed by
 * srmech_toml_parse, mirrored to JSON by this host's own iterative emitter, and
 * handed to the shipped C chain entry points. Nothing is generated by a Python
 * side-car (that is the confound the ADR-0003 criterion exists to exclude).
 *
 * WHAT IT DRIVES, and why there are two surfaces:
 *   SURFACE B (`[catalog].operator_chain`, chain_schema_version = 1) — the
 *     AMSC attested descriptors. Entry points srmech_chain_catalog_parse +
 *     srmech_catalog_run_chain. Expected to SUCCEED end-to-end, and the
 *     descriptor's own attested NDJSON row carries the expected value, so
 *     value parity is checked IN-PROCESS against shipped data with no Python
 *     reference needed.
 *   SURFACE A (`[[cascade.chain]]`, ADR-0008 schema v1/v2) — the 21 packaged
 *     cascade_catalog descriptors, i.e. the population gh #1653 is about.
 *     Entry points srmech_chain_spec_parse + srmech_chain_run, mirroring the
 *     Python projection srmech.dsl.run_cascade_chain ->
 *     srmech.cascade.compose.run_chain (which builds the chain dict as
 *     {name: "<op>.<variant>", summary, returns, steps} — see
 *     srmech/dsl/_cascade_chain.py:118-127; this host builds the same four
 *     keys so the comparison is a mirror, not a re-interpretation).
 *
 * THE CONFOUND GUARD (the whole point of section [0]):
 *   A chain that "C rejects" may be rejected by THIS HOST — wrong arena, wrong
 *   JSON shape, wrong entry point, bad marshalling. So section [0] runs a
 *   POSITIVE CONTROL through the *identical* surface-A code path: a synthetic
 *   in-file descriptor whose single step is `rational_add`, an op that IS in
 *   the C run loop's dispatch table. If that control does not parse, run, and
 *   return the exact rational 5/6, the host aborts and attributes NOTHING.
 *   Every rejection below therefore carries a C status code plus the C source
 *   line that produces it, or it is labelled HOST_LIMIT / UNATTRIBUTED.
 *
 * OUTPUT: NDJSON on stdout (one record per target + a summary), human tally on
 *   stderr. Per the project's "NDJSON over bloated JSON for results" rule.
 *
 * BUILD + RUN — see the block at the bottom of this comment.
 *
 * JPL Power-of-Ten discipline (this file). The wording below deliberately
 * avoids naming the banned constructs verbatim, because the shipped ratchet
 * (tests/test_jpl_audit.py) greps raw file text and a mention in a comment
 * reads as a violation:
 *   Rule 1  no unconditional jumps, no non-local control transfer, and NO
 *           RECURSION — the TOML->JSON mirror is an explicit-stack iterative
 *           traversal (tj_emit) bounded by TJ_MAX_DEPTH; the
 *           reference-namespace scan is a flat text scan with no stack at all.
 *   Rule 2  every loop has a bound (file count, table arity, buffer capacity).
 *   Rule 3  NO DYNAMIC ALLOCATION in this file. Every arena is a file-scope
 *           static, sized against the library's own *_arena_bytes() and
 *           reported per call so the figures are real MCU sizing data. (libc
 *           stdio / dirent allocate internally; that is not this code.)
 *   Rule 4  every function <= 60 lines.
 *   Rule 5  >= 2 assertions per function.
 *   Rule 6  smallest-scope declarations.
 *   Rule 7  every srmech_* return value is checked and reported.
 *   Rule 8  no multi-line macros.
 *
 * No ALU magnitude helper anywhere — sign handling is Class-K pin-slot per
 * project discipline, and this host performs none. No RNG. No float in any
 * decision path except the deliberate non-finite DECLINE in tj_scalar, which
 * mirrors srmech_json_write_ws's own refusal to emit a non-finite double.
 *
 * ------------------------------------------------------------------
 * REPRODUCE — both commands verbatim, from docs/srmech/ :
 *
 *   cc -std=c17 -Wall -Wextra -Wpedantic -Werror -O2 -Ic/include \
 *      -o /tmp/barec1653 notes/_1653_barec_host_rc444.c c/build/libsrmech.a
 *   /tmp/barec1653 python/srmech > notes/_1653_barec_host_rc444.ndjson
 *
 * Exit 0. `ldd /tmp/barec1653` lists libc only — no libpython, no libm — which
 * is the mechanical proof of the "no Python in the process" half of the claim.
 * If c/build/libsrmech.a is absent, build it first with `make lib` in c/.
 *
 * The OPTIONAL cross-check (a SEPARATE process; not part of the proof) is
 * notes/_1653_barec_host_verify_rc444.py, run from docs/srmech/python/ :
 *
 *   python3 ../notes/_1653_barec_host_verify_rc444.py \
 *           ../notes/_1653_barec_host_rc444.ndjson
 *
 * It re-derives each accepted chain's normalized-spec sha256 through the PURE
 * Python engine and requires equality with the C host's, which is what proves
 * this host's TOML->JSON mirror is faithful rather than merely self-consistent.
 * ------------------------------------------------------------------
 */

#include "srmech.h"

#include <assert.h>
#include <dirent.h>
#include <stdint.h>
#include <stdio.h>
#include <stdlib.h>
#include <string.h>

/* ----------------------------------------------------------------------
 * Compile-time envelopes. No dynamic allocation (JPL Rule 3): these are the whole
 * memory budget. Each is checked against the library's own *_arena_bytes()
 * before use, and a shortfall is reported as HOST_LIMIT (never as a C
 * rejection) so an under-sized arena can never inflate the measured gap.
 * ---------------------------------------------------------------------- */

#define HOST_SRC_CAP   (128u * 1024u)          /* descriptor TOML source     */
#define HOST_ND_CAP    (256u * 1024u)          /* (unused; ndjson via iter)  */
#define HOST_JSON_CAP  (128u * 1024u)          /* emitted chain / catalog IR */
#define HOST_CTX_CAP   (64u * 1024u)           /* emitted ctx IR             */
#define HOST_OUT_CAP   (64u * 1024u)           /* C entry-point out buffer   */
#define HOST_LINE_CAP  (16u * 1024u)           /* one NDJSON row             */
#define HOST_TOML_WS   (16u * 1024u * 1024u)   /* srmech_toml_parse arena    */
#define HOST_AUX_WS    (16u * 1024u * 1024u)   /* spec_parse / json_parse    */
#define HOST_RUN_WS    (72u * 1024u * 1024u)   /* chain_run arena            */
#define HOST_MAX_FILES 64u
#define HOST_NAME_CAP  96u
#define HOST_PATH_CAP  512u
#define TJ_MAX_DEPTH   24

static char          g_src[HOST_SRC_CAP];
static char          g_json[HOST_JSON_CAP];
static char          g_ctx[HOST_CTX_CAP];
static char          g_out[HOST_OUT_CAP];
static char          g_row[HOST_LINE_CAP];
static char          g_blk[512];
static char          g_sha[65];
static unsigned char g_toml_ws[HOST_TOML_WS];
static unsigned char g_aux_ws[HOST_AUX_WS];
static unsigned char g_run_ws[HOST_RUN_WS];
static char          g_names[HOST_MAX_FILES][HOST_NAME_CAP];

/* The C run loop's dispatch table, mirrored from
 * c/src/srmech_compose_run.c:581-620 cr_dispatch. Used ONLY to PREDICT a
 * rejection before measuring it (predict-then-measure); the verdict always
 * comes from the real status code. */
static const char *const C_RUN_OPS[10] = {
    "pi_cascade_digits",     "exp_series_truncate",   "sin_series_truncate",
    "cos_series_truncate",   "log1p_series_truncate", "atan_series_truncate",
    "rational_pow_uint",     "rational_add",          "rational_mul",
    "rational_div"
};

/* The reference namespaces the C parse gate knows, mirrored from
 * c/src/srmech_compose.c:135-149 co_match_namespace. Python knows three more
 * (idx / bind / op — compose.py:151-154). */
static const char *const C_REF_NS[4] = { "row", "input", "step", "catalog" };

/* A synthetic descriptor used ONLY as the section [0] positive control. It is
 * not shipped data; it exists so that a surface-A rejection below cannot be
 * this host's fault. Its op (rational_add) IS in C_RUN_OPS. */
static const char g_control_toml[] =
    "[cascade]\n"
    "name = \"hostctl\"\n"
    "purpose = \"host positive control\"\n"
    "[[cascade.chain]]\n"
    "chain_schema_version = 2\n"
    "summary = \"host positive control: one plain Class-N step\"\n"
    "returns = \"tuple[int, int]\"\n"
    "[[cascade.chain.steps]]\n"
    "class = \"N\"\n"
    "op = \"rational_add\"\n"
    "args = { a = \"@input.a\", b = \"@input.b\" }\n"
    "[[cascade.chain.proof_cases]]\n"
    "covers = \"control\"\n"
    "inputs = { a = [1, 2], b = [1, 3] }\n";

typedef struct host_tally {
    int a_descriptors, a_leaf, a_chains, a_spec_ok, a_spec_rej;
    int a_run_ok, a_run_rej, a_host_limit, a_unattributed;
    int b_targets, b_parse_ok, b_run_ok, b_parity_ok, b_host_limit;
    int controls_run, controls_ok;
} host_tally_t;

/* ----------------------------------------------------------------------
 * Bounded output buffer + JSON text emission.
 * ---------------------------------------------------------------------- */

typedef struct hb { char *p; size_t cap; size_t len; int failed; } hb_t;

static void hb_init(hb_t *o, char *buf, size_t cap)
{
    assert(o != NULL);
    assert(buf != NULL && cap > 1u);
    o->p = buf;
    o->cap = cap;
    o->len = 0u;
    o->failed = 0;
}

static void hb_ch(hb_t *o, char c)
{
    assert(o != NULL);
    assert(o->p != NULL);
    if (o->len + 2u >= o->cap) { o->failed = 1; return; }
    o->p[o->len++] = c;
    o->p[o->len] = '\0';
}

static void hb_raw(hb_t *o, const char *s, size_t n)
{
    assert(o != NULL);
    assert(s != NULL || n == 0u);
    if (o->len + n + 2u >= o->cap) { o->failed = 1; return; }
    memcpy(o->p + o->len, s, n);
    o->len += n;
    o->p[o->len] = '\0';
}

/* Emit s[0..n) as a JSON string literal (quotes included). Control bytes go
 * out as \u00XX; raw UTF-8 >= 0x20 passes through, which strict RFC 8259
 * (and srmech_json_parse) accepts. */
static void hb_jstr(hb_t *o, const char *s, size_t n)
{
    size_t i;
    assert(o != NULL);
    assert(s != NULL || n == 0u);
    hb_ch(o, '"');
    for (i = 0u; i < n; i++) {
        unsigned char c = (unsigned char)s[i];
        if (c == '"' || c == '\\') {
            hb_ch(o, '\\');
            hb_ch(o, (char)c);
        } else if (c < 0x20u) {
            char esc[8];
            int k = snprintf(esc, sizeof(esc), "\\u%04x", (unsigned int)c);
            (void)k;
            hb_raw(o, esc, 6u);
        } else {
            hb_ch(o, (char)c);
        }
    }
    hb_ch(o, '"');
}

/* One TOML scalar -> JSON text. Returns 0 on a DECLINE (a non-finite float),
 * mirroring srmech_json_write_ws's own refusal rather than emitting a token
 * srmech_json_parse would reject. The 1e308 bound also declines the handful of
 * finite doubles above it; no shipped descriptor carries one. */
static int tj_scalar(const srmech_toml_value_t *v, hb_t *o)
{
    char num[64];
    int k;
    assert(v != NULL);
    assert(o != NULL);
    if (v->type == SRMECH_TOML_STRING) {
        hb_jstr(o, v->u.str.ptr, v->u.str.len);
        return 1;
    }
    if (v->type == SRMECH_TOML_INT) {
        k = snprintf(num, sizeof(num), "%lld", (long long)v->u.i);
        if (k <= 0) { return 0; }
        hb_raw(o, num, (size_t)k);
        return 1;
    }
    if (v->type == SRMECH_TOML_BOOL) {
        hb_raw(o, v->u.b ? "true" : "false", v->u.b ? 4u : 5u);
        return 1;
    }
    if (v->type == SRMECH_TOML_FLOAT) {
        if (!(v->u.f > -1e308 && v->u.f < 1e308)) { return 0; }
        k = snprintf(num, sizeof(num), "%.17g", v->u.f);
        if (k <= 0) { return 0; }
        hb_raw(o, num, (size_t)k);
        return 1;
    }
    return 0;
}

typedef struct tj_frame { const srmech_toml_value_t *v; uint32_t i; } tj_frame_t;

/* Mirror a parsed TOML value tree to JSON text. ITERATIVE (JPL Rule 1: no
 * recursion) via an explicit frame stack bounded by TJ_MAX_DEPTH. Returns 0 on
 * a declined scalar, a depth overrun, or a full output buffer. */
static int tj_emit(const srmech_toml_value_t *root, hb_t *o)
{
    tj_frame_t st[TJ_MAX_DEPTH];
    int sp;
    assert(root != NULL);
    assert(o != NULL);
    st[0].v = root;
    st[0].i = 0u;
    sp = 1;
    while (sp > 0) {
        tj_frame_t *f = &st[sp - 1];
        const srmech_toml_value_t *v = f->v;
        const srmech_toml_value_t *child;
        uint32_t n;
        int is_arr = (v->type == SRMECH_TOML_ARRAY);
        if (!is_arr && v->type != SRMECH_TOML_TABLE) {
            if (!tj_scalar(v, o)) { return 0; }
            sp--;
            continue;
        }
        n = is_arr ? v->u.arr.n : v->u.tbl.n;
        if (f->i == 0u) { hb_ch(o, is_arr ? '[' : '{'); }
        if (f->i >= n) {
            hb_ch(o, is_arr ? ']' : '}');
            sp--;
            continue;
        }
        if (f->i > 0u) { hb_ch(o, ','); }
        if (is_arr) {
            child = v->u.arr.items[f->i];
        } else {
            const char *key = v->u.tbl.keys[f->i];
            hb_jstr(o, key, strlen(key));
            hb_ch(o, ':');
            child = v->u.tbl.vals[f->i];
        }
        f->i++;
        if (sp >= TJ_MAX_DEPTH || child == NULL) { return 0; }
        st[sp].v = child;
        st[sp].i = 0u;
        sp++;
    }
    return o->failed ? 0 : 1;
}

/* ----------------------------------------------------------------------
 * Small TOML / JSON accessors + file slurp.
 * ---------------------------------------------------------------------- */

static const srmech_toml_value_t *tv_get(const srmech_toml_value_t *t,
                                         const char *key)
{
    assert(key != NULL);
    assert(key[0] != '\0');
    if (t == NULL || t->type != SRMECH_TOML_TABLE) { return NULL; }
    return srmech_toml_table_get(t, key);
}

/* The n-th entry of an array-of-tables, tolerating the single-table spelling
 * TOML produces when only one [[x]] block exists in some writers. */
static const srmech_toml_value_t *tv_entry(const srmech_toml_value_t *v,
                                           uint32_t idx, uint32_t *out_n)
{
    assert(out_n != NULL);
    assert(idx < 0x7fffffffu);
    if (v == NULL) { *out_n = 0u; return NULL; }
    if (v->type == SRMECH_TOML_TABLE) {
        *out_n = 1u;
        return (idx == 0u) ? v : NULL;
    }
    if (v->type != SRMECH_TOML_ARRAY) { *out_n = 0u; return NULL; }
    *out_n = v->u.arr.n;
    return (idx < v->u.arr.n) ? v->u.arr.items[idx] : NULL;
}

static int tv_str(const srmech_toml_value_t *t, const char *key,
                  const char **p, uint32_t *n)
{
    const srmech_toml_value_t *m = tv_get(t, key);
    assert(p != NULL && n != NULL);
    assert(key != NULL);
    if (m == NULL || m->type != SRMECH_TOML_STRING) { return 0; }
    *p = m->u.str.ptr;
    *n = m->u.str.len;
    return 1;
}

static srmech_status_t slurp(const char *path, char *buf, size_t cap,
                            size_t *out_len)
{
    FILE *fp;
    size_t n;
    assert(path != NULL);
    assert(buf != NULL && out_len != NULL && cap > 0u);
    fp = fopen(path, "rb");
    if (fp == NULL) { return SRMECH_ERR_IO; }
    n = fread(buf, 1u, cap, fp);
    (void)fclose(fp);
    if (n == 0u) { return SRMECH_ERR_IO; }
    if (n >= cap) { return SRMECH_ERR_OVERFLOW; }
    buf[n] = '\0';
    *out_len = n;
    return SRMECH_OK;
}

static const srmech_json_value_t *j_parse(const char *s, size_t n,
                                          void *ws, size_t wsn)
{
    srmech_json_value_t *t = NULL;
    assert(s != NULL);
    assert(ws != NULL && wsn > 0u);
    if (srmech_json_parse(s, n, ws, wsn, &t) != SRMECH_OK) { return NULL; }
    return t;
}

static int j_str(const srmech_json_value_t *o, const char *key,
                 const char **p, uint32_t *n)
{
    const srmech_json_value_t *m;
    assert(key != NULL);
    assert(p != NULL && n != NULL);
    if (o == NULL || o->type != SRMECH_JSON_OBJECT) { return 0; }
    m = srmech_json_object_get(o, key);
    if (m == NULL || m->type != SRMECH_JSON_STRING) { return 0; }
    *p = m->u.str.ptr;
    *n = m->u.str.len;
    return 1;
}

/* ----------------------------------------------------------------------
 * Static PREDICTORS (mirrors of the C gates, used predict-then-measure).
 * ---------------------------------------------------------------------- */

static int op_in_c_table(const char *s, uint32_t n)
{
    int i;
    assert(s != NULL || n == 0u);
    assert(n < 4096u);
    for (i = 0; i < 10; i++) {
        size_t l = strlen(C_RUN_OPS[i]);
        if (l == (size_t)n && memcmp(s, C_RUN_OPS[i], l) == 0) { return 1; }
    }
    return 0;
}

/* Step form per compose.py: 0 = plain (class+op+args, the ONLY form C builds,
 * srmech_compose.c:299-303), 1 = map (map_over+body), 2 = fold
 * (fold_class+fold_op+fold_init+over), 3 = unrecognised. */
static int a_step_form(const srmech_toml_value_t *s)
{
    assert(s != NULL);
    if (s->type != SRMECH_TOML_TABLE) { return 3; }
    assert(s->u.tbl.keys != NULL || s->u.tbl.n == 0u);
    if (tv_get(s, "map_over") != NULL || tv_get(s, "body") != NULL) { return 1; }
    if (tv_get(s, "fold_op") != NULL || tv_get(s, "fold_class") != NULL) { return 2; }
    if (tv_get(s, "class") != NULL && tv_get(s, "op") != NULL
        && tv_get(s, "args") != NULL) { return 0; }
    return 3;
}

/* Count reference namespaces the C parse gate does NOT know, by flat text scan
 * over the ALREADY-EMITTED chain JSON (sees every nesting depth, no stack). */
static int ns_unknown_count(const char *js, size_t n, char *out, size_t cap)
{
    size_t i;
    int bad = 0;
    assert(js != NULL);
    assert(out != NULL && cap > 8u);
    out[0] = '\0';
    for (i = 0u; i + 2u < n; i++) {
        size_t j, k;
        int known = 0;
        if (js[i] != '"' || js[i + 1] != '@') { continue; }
        j = i + 2u;
        while (j < n && js[j] != '.' && js[j] != '[' && js[j] != '"') { j++; }
        for (k = 0u; k < 4u; k++) {
            size_t l = strlen(C_REF_NS[k]);
            if (l == j - (i + 2u) && memcmp(js + i + 2u, C_REF_NS[k], l) == 0) {
                known = 1;
            }
        }
        if (known) { continue; }
        bad++;
        if (strlen(out) + (j - i) + 4u < cap) {
            size_t o = strlen(out);
            if (o > 0u) { out[o++] = '|'; }
            memcpy(out + o, js + i + 1u, j - (i + 1u));
            out[o + (j - (i + 1u))] = '\0';
        }
    }
    return bad;
}

/* Count FLOAT / BOOL scalars anywhere under `root`, iteratively (same explicit
 * frame stack as tj_emit; no recursion). These are the values the run loop's
 * arg marshaller cr_json_scalar (srmech_compose_run.c:207-220) DECLINES — it
 * accepts INT, NULL and STRING only. So this counter measures the SECOND wall,
 * the one the op-table gap currently masks: widening cr_dispatch's table alone
 * would still leave every chain with a float or bool argument declining. */
static void tv_count_fb(const srmech_toml_value_t *root, int *n_float,
                        int *n_bool)
{
    tj_frame_t st[TJ_MAX_DEPTH];
    int sp;
    assert(n_float != NULL && n_bool != NULL);
    assert(TJ_MAX_DEPTH > 2);
    *n_float = 0;
    *n_bool = 0;
    if (root == NULL) { return; }
    st[0].v = root;
    st[0].i = 0u;
    sp = 1;
    while (sp > 0) {
        tj_frame_t *f = &st[sp - 1];
        const srmech_toml_value_t *v = f->v;
        int is_arr = (v->type == SRMECH_TOML_ARRAY);
        uint32_t n;
        if (!is_arr && v->type != SRMECH_TOML_TABLE) {
            if (v->type == SRMECH_TOML_FLOAT) { (*n_float)++; }
            if (v->type == SRMECH_TOML_BOOL) { (*n_bool)++; }
            sp--;
            continue;
        }
        n = is_arr ? v->u.arr.n : v->u.tbl.n;
        if (f->i >= n) { sp--; continue; }
        st[sp].v = is_arr ? v->u.arr.items[f->i] : v->u.tbl.vals[f->i];
        f->i++;
        if (sp >= TJ_MAX_DEPTH - 1 || st[sp].v == NULL) { return; }
        st[sp].i = 0u;
        sp++;
    }
}

/* ----------------------------------------------------------------------
 * SURFACE A — the cascade_catalog `[[cascade.chain]]` population.
 * ---------------------------------------------------------------------- */

/* Build the chain JSON exactly as srmech/dsl/_cascade_chain.py:118-127 builds
 * the dict it hands to compose.parse_chain_spec: the four keys name / summary /
 * returns / steps, with name = "<op>.<variant|default>" and summary falling
 * back to [cascade].purpose. Returns 0 = HOST_LIMIT (emit failed). */
static int a_chain_json(const char *op, const srmech_toml_value_t *casc,
                        const srmech_toml_value_t *entry, hb_t *o)
{
    const char *p = NULL;
    uint32_t n = 0u;
    const srmech_toml_value_t *steps;
    assert(op != NULL && casc != NULL);
    assert(entry != NULL && o != NULL);
    steps = tv_get(entry, "steps");
    if (steps == NULL) { return 0; }
    hb_raw(o, "{\"name\":", 8u);
    hb_ch(o, '"');
    hb_raw(o, op, strlen(op));
    hb_ch(o, '.');
    if (tv_str(entry, "variant", &p, &n)) { hb_raw(o, p, n); }
    else { hb_raw(o, "default", 7u); }
    hb_ch(o, '"');
    hb_raw(o, ",\"summary\":", 11u);
    if (tv_str(entry, "summary", &p, &n) || tv_str(casc, "purpose", &p, &n)) {
        hb_jstr(o, p, n);
    } else {
        hb_jstr(o, op, strlen(op));
    }
    hb_raw(o, ",\"returns\":", 11u);
    if (tv_str(entry, "returns", &p, &n)) { hb_jstr(o, p, n); }
    else { hb_jstr(o, "", 0u); }
    hb_raw(o, ",\"steps\":", 9u);
    if (!tj_emit(steps, o)) { return 0; }
    hb_ch(o, '}');
    return o->failed ? 0 : 1;
}

/* ctx = {"row": null, "inputs": <proof_cases[0].inputs>} — the shape
 * compose.run_chain(spec, inputs=bound) builds. */
static int a_ctx_json(const srmech_toml_value_t *entry, hb_t *o)
{
    uint32_t np = 0u;
    const srmech_toml_value_t *pc0, *ins;
    assert(entry != NULL);
    assert(o != NULL);
    hb_raw(o, "{\"row\":null,\"inputs\":", 21u);
    pc0 = tv_entry(tv_get(entry, "proof_cases"), 0u, &np);
    ins = (pc0 != NULL) ? tv_get(pc0, "inputs") : NULL;
    if (ins == NULL) { hb_raw(o, "{}", 2u); }
    else if (!tj_emit(ins, o)) { return 0; }
    hb_ch(o, '}');
    return o->failed ? 0 : 1;
}

/* Per-chain static blocker census (what the C gates will refuse, and why),
 * written into g_blk. Purely predictive; the verdict is the measured rc. */
static void a_blockers(const srmech_toml_value_t *entry, const char *js,
                       size_t jsn, int *n_map, int *n_fold, int *n_offtab)
{
    uint32_t i, ns = 0u;
    const srmech_toml_value_t *steps;
    assert(entry != NULL && js != NULL);
    assert(n_map != NULL && n_fold != NULL && n_offtab != NULL);
    *n_map = 0; *n_fold = 0; *n_offtab = 0;
    steps = tv_get(entry, "steps");
    (void)tv_entry(steps, 0u, &ns);
    for (i = 0u; i < ns; i++) {
        uint32_t dummy = 0u;
        const srmech_toml_value_t *s = tv_entry(steps, i, &dummy);
        const char *op = NULL;
        uint32_t opl = 0u;
        int form;
        if (s == NULL) { continue; }
        form = a_step_form(s);
        if (form == 1) { (*n_map)++; }
        if (form == 2) { (*n_fold)++; }
        if (form == 0 && tv_str(s, "op", &op, &opl)
            && !op_in_c_table(op, opl)) { (*n_offtab)++; }
    }
    (void)ns_unknown_count(js, jsn, g_blk, sizeof(g_blk));
}

/* Fill pred[6] = {map_steps, fold_steps, ops_off_table, unknown_ns,
 * float_args, bool_args} for one chain entry. Split out of a_run_variant for
 * JPL Rule 4. The float/bool census covers ONLY what the run loop actually
 * marshals — the step declarations (literal args + map bodies) plus the ONE
 * proof case this host binds as ctx. Counting the whole chain entry would fold
 * in every other proof case, and the field name would then overstate it. */
static void a_predict(const srmech_toml_value_t *entry, const char *js,
                      size_t jsn, int *pred)
{
    int f2 = 0, b2 = 0;
    uint32_t np = 0u;
    const srmech_toml_value_t *pc0;
    assert(entry != NULL && js != NULL);
    assert(pred != NULL);
    pred[3] = ns_unknown_count(js, jsn, g_blk, sizeof(g_blk));
    a_blockers(entry, js, jsn, &pred[0], &pred[1], &pred[2]);
    pc0 = tv_entry(tv_get(entry, "proof_cases"), 0u, &np);
    tv_count_fb(tv_get(entry, "steps"), &pred[4], &pred[5]);
    tv_count_fb((pc0 != NULL) ? tv_get(pc0, "inputs") : NULL, &f2, &b2);
    pred[4] += f2;
    pred[5] += b2;
}

/* Emit one surface-A NDJSON record. Split out of a_run_variant purely to hold
 * both functions under the 60-line JPL Rule 4 bound. Reads g_sha / g_blk /
 * g_out, which a_run_variant has just filled. */
static void a_emit(const char *op, const hb_t *cj, const hb_t *cx,
                   srmech_status_t rp, srmech_status_t rr,
                   const int *pred, size_t need_s, size_t need_r)
{
    assert(op != NULL && pred != NULL);
    assert(cj != NULL && cx != NULL);
    printf("{\"section\":\"A\",\"op\":\"%s\",\"chain_bytes\":%zu,"
           "\"ctx_bytes\":%zu,\"spec_parse_rc\":%d,\"spec_sha256\":\"%s\","
           "\"chain_run_rc\":%d,"
           "\"value\":%s,\"pred_map_steps\":%d,\"pred_fold_steps\":%d,"
           "\"pred_ops_off_table\":%d,\"pred_unknown_ns\":%d,"
           "\"pred_float_args\":%d,\"pred_bool_args\":%d,"
           "\"unknown_ns\":\"%s\",\"arena_spec_need\":%zu,"
           "\"arena_run_need\":%zu,\"verdict\":\"%s\"}\n",
           op, cj->len, cx->len, (int)rp, g_sha, (int)rr,
           (rr == SRMECH_OK) ? g_out : "null",
           pred[0], pred[1], pred[2], pred[3], pred[4], pred[5], g_blk,
           need_s, need_r,
           (rr == SRMECH_OK) ? "C_RAN" : "C_DECLINED");
}

/* Emit a HOST_LIMIT record — a refusal by THIS HOST, never by C. Kept distinct
 * from C_DECLINED so a harness shortfall can never be counted as a C gap. */
static void a_host_limit(const char *op, const char *why, size_t ns, size_t nr)
{
    assert(op != NULL);
    assert(why != NULL);
    printf("{\"section\":\"A\",\"op\":\"%s\",\"verdict\":\"HOST_LIMIT\","
           "\"why\":\"%s\",\"need_spec\":%zu,\"need_run\":%zu}\n",
           op, why, ns, nr);
}

/* Drive both surface-A entry points for ONE chain variant and emit its NDJSON
 * record. Returns 1 if the chain ran to a value in C. */
static int a_run_variant(const char *op, const srmech_toml_value_t *casc,
                         const srmech_toml_value_t *entry, host_tally_t *t)
{
    hb_t cj, cx;
    size_t need_s, need_r, ol = 0u;
    srmech_status_t rp, rr;
    /* pred[] = {map_steps, fold_steps, ops_off_table, unknown_ns,
     *           float_args, bool_args} — static predictions, measured after. */
    int pred[6] = {0, 0, 0, 0, 0, 0};
    assert(op != NULL && casc != NULL);
    assert(entry != NULL && t != NULL);
    hb_init(&cj, g_json, sizeof(g_json));
    hb_init(&cx, g_ctx, sizeof(g_ctx));
    t->a_chains++;
    if (!a_chain_json(op, casc, entry, &cj) || !a_ctx_json(entry, &cx)) {
        t->a_host_limit++;
        a_host_limit(op, "chain or ctx emit failed", 0u, 0u);
        return 0;
    }
    a_predict(entry, cj.p, cj.len, pred);
    need_s = srmech_chain_spec_parse_arena_bytes(cj.len);
    need_r = srmech_chain_run_arena_bytes(cj.len, cx.len);
    if (need_s > sizeof(g_aux_ws) || need_r > sizeof(g_run_ws)) {
        t->a_host_limit++;
        a_host_limit(op, "static arena short", need_s, need_r);
        return 0;
    }
    /* The C entry points write NO trailing NUL (documented contract), so the
     * host must terminate at *out_len before any %s use. Getting this wrong is
     * how the first run of this harness printed a stale tail.
     * The Class-A hash below content-addresses the NORMALIZED spec: it is the
     * cross-check that the host's TOML->JSON mirror is FAITHFUL for every
     * accepting chain, not just for the control. */
    rp = srmech_chain_spec_parse(cj.p, cj.len, g_aux_ws, sizeof(g_aux_ws),
                                 g_out, sizeof(g_out) - 1u, &ol);
    g_sha[0] = '\0';
    if (rp == SRMECH_OK) {
        t->a_spec_ok++;
        if (srmech_sha256_hex((const uint8_t *)g_out, ol, g_sha) != SRMECH_OK) {
            g_sha[0] = '\0';
        }
    } else {
        t->a_spec_rej++;
    }
    ol = 0u;
    rr = srmech_chain_run(cj.p, cj.len, cx.p, cx.len, g_run_ws,
                          sizeof(g_run_ws), g_out, sizeof(g_out) - 1u, &ol);
    g_out[(rr == SRMECH_OK && ol < sizeof(g_out)) ? ol : 0u] = '\0';
    a_emit(op, &cj, &cx, rp, rr, pred, need_s, need_r);
    if (rr == SRMECH_OK) { t->a_run_ok++; return 1; }
    t->a_run_rej++;
    /* A rejection with NO predicted cause is UNATTRIBUTED and must be reported
     * as such — an unattributed rejection is worse than none, because it
     * inflates the gap. Held at strict zero by the summary. */
    if (pred[0] == 0 && pred[1] == 0 && pred[2] == 0 && pred[3] == 0) {
        t->a_unattributed++;
    }
    return 0;
}

/* One descriptor file: parse it, walk every declared [[cascade.chain]]. */
static void a_descriptor(const char *dir, const char *fname, host_tally_t *t)
{
    char path[HOST_PATH_CAP];
    size_t n = 0u;
    srmech_toml_value_t *root = NULL;
    const srmech_toml_value_t *casc, *chain;
    const char *nm = NULL;
    uint32_t nl = 0u, nch = 0u, i;
    assert(dir != NULL && fname != NULL);
    assert(t != NULL);
    (void)snprintf(path, sizeof(path), "%.*s/%.*s",
                   (int)(HOST_PATH_CAP / 2u), dir,
                   (int)(HOST_NAME_CAP - 1u), fname);
    if (slurp(path, g_src, sizeof(g_src), &n) != SRMECH_OK) { return; }
    if (srmech_toml_parse(g_src, n, g_toml_ws, sizeof(g_toml_ws),
                          &root) != SRMECH_OK) {
        printf("{\"section\":\"A\",\"file\":\"%s\",\"verdict\":\"HOST_LIMIT\","
               "\"why\":\"srmech_toml_parse declined\"}\n", fname);
        t->a_host_limit++;
        return;
    }
    t->a_descriptors++;
    casc = tv_get(root, "cascade");
    if (!tv_str(casc, "name", &nm, &nl)) { return; }
    chain = tv_get(casc, "chain");
    (void)tv_entry(chain, 0u, &nch);
    if (nch == 0u) {
        t->a_leaf++;
        printf("{\"section\":\"A\",\"op\":\"%.*s\",\"verdict\":\"LEAF\"}\n",
               (int)nl, nm);
        return;
    }
    for (i = 0u; i < nch; i++) {
        uint32_t d = 0u;
        const srmech_toml_value_t *e = tv_entry(chain, i, &d);
        char opname[HOST_NAME_CAP];
        (void)snprintf(opname, sizeof(opname), "%.*s", (int)nl, nm);
        if (e != NULL) { (void)a_run_variant(opname, casc, e, t); }
    }
}

/* ----------------------------------------------------------------------
 * SURFACE B — the AMSC `[catalog].operator_chain` population.
 * ---------------------------------------------------------------------- */

typedef struct row_pick {
    const char *want;
    int         found;
} row_pick_t;

/* srmech_ndjson_iter callback: keep the FIRST data row whose chain_id matches.
 * '#' comment lines are the descriptor's own convention, not NDJSON's. */
static srmech_status_t b_row_cb(const char *line, size_t len, size_t lineno,
                                void *user)
{
    row_pick_t *pk = (row_pick_t *)user;
    const srmech_json_value_t *r;
    const char *cid = NULL;
    uint32_t cl = 0u;
    assert(line != NULL || len == 0u);
    assert(user != NULL);
    (void)lineno;
    if (pk->found || len == 0u || line[0] == '#' || len + 2u >= sizeof(g_row)) {
        return SRMECH_OK;
    }
    r = j_parse(line, len, g_aux_ws, sizeof(g_aux_ws));
    if (!j_str(r, "chain_id", &cid, &cl)) { return SRMECH_OK; }
    if (strlen(pk->want) != (size_t)cl
        || memcmp(cid, pk->want, (size_t)cl) != 0) { return SRMECH_OK; }
    memcpy(g_row, line, len);
    g_row[len] = '\0';
    pk->found = 1;
    return SRMECH_OK;
}

/* Compare the C value descriptor against the row's OWN attested expectation.
 * "s" -> expected_pi_string; "q" -> expected_num / expected_den. Returns 1 on
 * byte/value parity, 0 otherwise, -1 if the row declares no expectation. */
static int b_parity(const char *desc, size_t dn, const char *row, size_t rn)
{
    const srmech_json_value_t *d, *r, *m;
    const char *k = NULL, *v = NULL;
    uint32_t kl = 0u, vl = 0u;
    assert(desc != NULL && row != NULL);
    assert(dn > 0u && rn > 0u);
    d = j_parse(desc, dn, g_aux_ws, sizeof(g_aux_ws));
    r = j_parse(row, rn, g_aux_ws + sizeof(g_aux_ws) / 2u,
                sizeof(g_aux_ws) / 2u);
    if (d == NULL || r == NULL || !j_str(d, "k", &k, &kl)) { return 0; }
    if (kl == 1u && k[0] == 's' && j_str(d, "v", &v, &vl)) {
        const char *e = NULL;
        uint32_t el = 0u;
        if (!j_str(r, "expected_pi_string", &e, &el)) { return -1; }
        return (el == vl && memcmp(e, v, vl) == 0) ? 1 : 0;
    }
    if (kl == 1u && k[0] == 'q' && j_str(d, "n", &v, &vl)) {
        long long gn = strtoll(v, NULL, 10), gd = 0;
        if (!j_str(d, "d", &v, &vl)) { return 0; }
        gd = strtoll(v, NULL, 10);
        m = srmech_json_object_get(r, "expected_num");
        if (m == NULL || m->type != SRMECH_JSON_INT) { return -1; }
        if (m->u.i != gn) { return 0; }
        m = srmech_json_object_get(r, "expected_den");
        if (m == NULL || m->type != SRMECH_JSON_INT) { return -1; }
        return (m->u.i == gd) ? 1 : 0;
    }
    return -1;
}

/* Emit one surface-B NDJSON record (split out for JPL Rule 4). */
static void b_emit(const char *chain_name, size_t cjl, size_t cxl,
                   srmech_status_t rp, srmech_status_t rr, int par, size_t need)
{
    assert(chain_name != NULL);
    assert(chain_name[0] != '\0');
    printf("{\"section\":\"B\",\"chain\":\"%s\",\"catalog_bytes\":%zu,"
           "\"ctx_bytes\":%zu,\"catalog_parse_rc\":%d,\"catalog_run_rc\":%d,"
           "\"value\":%s,\"attested_parity\":%d,\"arena_run_need\":%zu,"
           "\"verdict\":\"%s\"}\n",
           chain_name, cjl, cxl, (int)rp, (int)rr,
           (rr == SRMECH_OK) ? g_out : "null", par, need,
           (rr == SRMECH_OK && par == 1) ? "C_RAN_PARITY_OK"
                                         : (rr == SRMECH_OK ? "C_RAN"
                                                            : "C_DECLINED"));
}

/* One surface-B target: a shipped AMSC descriptor + one of its declared
 * `[[catalog.operator_chain]]` names + its shipped attested NDJSON. */
static void b_target(const char *dir, const char *chain_name,
                     host_tally_t *t)
{
    char path[HOST_PATH_CAP];
    hb_t cj, cx;
    size_t n = 0u, ol = 0u, need;
    srmech_toml_value_t *root = NULL;
    row_pick_t pk;
    srmech_status_t rp, rr;
    int par = -1;
    assert(dir != NULL && chain_name != NULL);
    assert(t != NULL);
    t->b_targets++;
    hb_init(&cj, g_json, sizeof(g_json));
    hb_init(&cx, g_ctx, sizeof(g_ctx));
    (void)snprintf(path, sizeof(path), "%s/descriptor.toml", dir);
    if (slurp(path, g_src, sizeof(g_src), &n) != SRMECH_OK
        || srmech_toml_parse(g_src, n, g_toml_ws, sizeof(g_toml_ws),
                             &root) != SRMECH_OK
        || !tj_emit(tv_get(root, "catalog"), &cj)) {
        t->b_host_limit++;
        printf("{\"section\":\"B\",\"chain\":\"%s\",\"verdict\":\"HOST_LIMIT\","
               "\"why\":\"descriptor read/parse/emit failed\"}\n", chain_name);
        return;
    }
    pk.want = chain_name;
    pk.found = 0;
    (void)snprintf(path, sizeof(path), "%s/row.ndjson", dir);
    if (srmech_ndjson_iter(path, b_row_cb, &pk) != SRMECH_OK || !pk.found) {
        t->b_host_limit++;
        printf("{\"section\":\"B\",\"chain\":\"%s\",\"verdict\":\"HOST_LIMIT\","
               "\"why\":\"no attested row for this chain_id\"}\n", chain_name);
        return;
    }
    /* ctx = {"row": <the attested NDJSON row VERBATIM>, "inputs": {}} — the row
     * line is already valid JSON, so no re-encoding step can corrupt it. */
    hb_raw(&cx, "{\"row\":", 7u);
    hb_raw(&cx, g_row, strlen(g_row));
    hb_raw(&cx, ",\"inputs\":{}}", 13u);
    need = srmech_catalog_run_chain_arena_bytes(cj.len, cx.len);
    rp = srmech_chain_catalog_parse(cj.p, cj.len, g_aux_ws, sizeof(g_aux_ws),
                                    g_out, sizeof(g_out) - 1u, &ol);
    if (rp == SRMECH_OK) { t->b_parse_ok++; }
    ol = 0u;
    rr = (need > sizeof(g_run_ws)) ? SRMECH_ERR_OVERFLOW
       : srmech_catalog_run_chain(cj.p, cj.len, chain_name, strlen(chain_name),
                                  cx.p, cx.len, g_run_ws, sizeof(g_run_ws),
                                  g_out, sizeof(g_out) - 1u, &ol);
    g_out[(rr == SRMECH_OK && ol < sizeof(g_out)) ? ol : 0u] = '\0';
    if (rr == SRMECH_OK) {
        t->b_run_ok++;
        par = b_parity(g_out, ol, g_row, strlen(g_row));
        if (par == 1) { t->b_parity_ok++; }
    }
    b_emit(chain_name, cj.len, cx.len, rp, rr, par, need);
}

/* ----------------------------------------------------------------------
 * Section [0] — the POSITIVE CONTROL through the surface-A code path.
 * ---------------------------------------------------------------------- */

static int host_control(host_tally_t *t)
{
    srmech_toml_value_t *root = NULL;
    const srmech_toml_value_t *casc, *e;
    host_tally_t ct;                 /* the control's OWN counters, so it can
                                      * never inflate the shipped census */
    uint32_t nch = 0u;
    int ran;
    assert(t != NULL);
    assert(sizeof(g_control_toml) > 64u);
    memset(&ct, 0, sizeof(ct));
    t->controls_run++;
    if (srmech_toml_parse(g_control_toml, sizeof(g_control_toml) - 1u,
                          g_toml_ws, sizeof(g_toml_ws), &root) != SRMECH_OK) {
        printf("{\"section\":\"0\",\"control\":\"toml_parse\","
               "\"verdict\":\"CONTROL_FAILED\"}\n");
        return 0;
    }
    casc = tv_get(root, "cascade");
    e = tv_entry(tv_get(casc, "chain"), 0u, &nch);
    if (e == NULL) {
        printf("{\"section\":\"0\",\"control\":\"chain_lookup\","
               "\"verdict\":\"CONTROL_FAILED\"}\n");
        return 0;
    }
    ran = a_run_variant("hostctl", casc, e, &ct);
    /* The control's own value must be the exact rational 5/6. The separators
     * are canonical json.dumps's ": " / ", " — NOT the compact spelling. */
    if (ran && strstr(g_out, "\"k\": \"q\"") != NULL
        && strstr(g_out, "\"n\": \"5\"") != NULL
        && strstr(g_out, "\"d\": \"6\"") != NULL) {
        t->controls_ok++;
        printf("{\"section\":\"0\",\"control\":\"rational_add\","
               "\"value\":%s,\"verdict\":\"CONTROL_OK\"}\n", g_out);
        return 1;
    }
    printf("{\"section\":\"0\",\"control\":\"rational_add\","
           "\"verdict\":\"CONTROL_FAILED\"}\n");
    return 0;
}

/* Section [3] — the same computation the cyclic_gcd chain declares, called
 * directly. Shows whether the surface-A wall is a MISSING KERNEL or only a
 * missing dispatch-table entry. */
static void kernel_probe(void)
{
    uint64_t g1 = 0u, g2 = 0u;
    srmech_status_t s1, s2;
    assert(sizeof(uint64_t) == 8u);
    assert(srmech_abi_version() > 0);
    s1 = srmech_gcd(12u, 18u, &g1);
    s2 = srmech_cascade_cyclic_gcd_u64(12u, 18u, &g2);
    printf("{\"section\":\"3\",\"probe\":\"class_I_gcd_kernels_exist\","
           "\"srmech_gcd_rc\":%d,\"srmech_gcd_value\":%llu,"
           "\"srmech_cascade_cyclic_gcd_u64_rc\":%d,"
           "\"srmech_cascade_cyclic_gcd_u64_value\":%llu,"
           "\"chain_declares\":\"class=I op=gcd args={a=@input.a,b=@input.b}\","
           "\"reading\":\"kernel present; the wall is cr_dispatch's op table\"}\n",
           (int)s1, (unsigned long long)g1, (int)s2, (unsigned long long)g2);
}

/* Drive the COMPLETE shipped `[[catalog.operator_chain]]` population: seven
 * chains across three AMSC descriptors. The fourth descriptor that has a
 * [catalog] table, amsc/attested/literature_claims, declares NO operator_chain
 * deliberately — its own descriptor.toml documents that its rows measure an
 * EXTERNAL document and no cascade of the fourteen can re-derive them — so
 * seven is the whole population, not a sample. */
static void b_all_targets(const char *root, host_tally_t *t)
{
    char dir[HOST_PATH_CAP];
    assert(root != NULL);
    assert(t != NULL);
    (void)snprintf(dir, sizeof(dir), "%.*s/amsc/attested/pi_digits",
                   (int)(HOST_PATH_CAP / 2u), root);
    b_target(dir, "pi_cascade_digits", t);
    (void)snprintf(dir, sizeof(dir), "%.*s/amsc/attested/asymptotic_calculus",
                   (int)(HOST_PATH_CAP / 2u), root);
    b_target(dir, "exp_series_truncate", t);
    b_target(dir, "sin_series_truncate", t);
    b_target(dir, "cos_series_truncate", t);
    b_target(dir, "log1p_series_truncate", t);
    b_target(dir, "atan_series_truncate", t);
    /* The strongest surface-B target: NINE steps, array-of-@row args, and a
     * @step[N].output reference chain (steps 2..8 each consume earlier
     * outputs). If this runs, the bare-C host is exercising the reference
     * grammar and multi-step value threading over bignum-Q, not just a
     * single-step delegation. */
    (void)snprintf(dir, sizeof(dir), "%.*s/amsc/attested/cosmos_validation",
                   (int)(HOST_PATH_CAP / 2u), root);
    b_target(dir, "friedmann_dark_fraction", t);
}

/* ----------------------------------------------------------------------
 * Directory enumeration (deterministic order; no magic filename list).
 * ---------------------------------------------------------------------- */

static uint32_t list_tomls(const char *dir)
{
    DIR *d;
    struct dirent *de;
    uint32_t n = 0u, i, j;
    assert(dir != NULL);
    assert(HOST_MAX_FILES > 1u);
    d = opendir(dir);
    if (d == NULL) { return 0u; }
    while ((de = readdir(d)) != NULL && n < HOST_MAX_FILES) {
        size_t l = strlen(de->d_name);
        if (l < 6u || l >= HOST_NAME_CAP) { continue; }
        if (memcmp(de->d_name + l - 5u, ".toml", 5u) != 0) { continue; }
        memcpy(g_names[n], de->d_name, l + 1u);
        n++;
    }
    (void)closedir(d);
    for (i = 1u; i < n; i++) {              /* insertion sort: stable order */
        char key[HOST_NAME_CAP];
        memcpy(key, g_names[i], HOST_NAME_CAP);
        j = i;
        while (j > 0u && strcmp(g_names[j - 1u], key) > 0) {
            memcpy(g_names[j], g_names[j - 1u], HOST_NAME_CAP);
            j--;
        }
        memcpy(g_names[j], key, HOST_NAME_CAP);
    }
    return n;
}

/* ---------------------------------------------------------------------- */

int main(int argc, char **argv)
{
    host_tally_t t;
    char dir[HOST_PATH_CAP];
    const char *root = (argc > 1) ? argv[1] : "python/srmech";
    uint32_t nf, i;
    assert(argc >= 1);
    assert(root != NULL && root[0] != '\0');
    memset(&t, 0, sizeof(t));
    printf("{\"section\":\"framing\",\"probe\":\"gh1653_barec_host\","
           "\"srmech_version\":\"%s\",\"abi\":%d,\"python_in_process\":false,"
           "\"static_bytes\":%zu,\"pkg_root\":\"%s\"}\n",
           srmech_version(), srmech_abi_version(),
           sizeof(g_toml_ws) + sizeof(g_aux_ws) + sizeof(g_run_ws), root);

    if (!host_control(&t)) {
        fprintf(stderr, "ABORT: positive control failed; attributing nothing\n");
        return 2;
    }

    b_all_targets(root, &t);

    (void)snprintf(dir, sizeof(dir), "%s/cascade/catalogs/cascade_catalog", root);
    nf = list_tomls(dir);
    for (i = 0u; i < nf; i++) { a_descriptor(dir, g_names[i], &t); }

    kernel_probe();
    printf("{\"section\":\"summary\",\"controls\":%d,\"controls_ok\":%d,"
           "\"B_targets\":%d,\"B_catalog_parse_ok\":%d,\"B_run_ok\":%d,"
           "\"B_attested_parity_ok\":%d,\"B_host_limit\":%d,"
           "\"A_descriptors\":%d,\"A_leaf\":%d,\"A_chain_variants\":%d,"
           "\"A_spec_parse_ok\":%d,\"A_spec_parse_rej\":%d,\"A_run_ok\":%d,"
           "\"A_run_rej\":%d,\"A_host_limit\":%d,\"A_unattributed\":%d}\n",
           t.controls_run, t.controls_ok, t.b_targets, t.b_parse_ok,
           t.b_run_ok, t.b_parity_ok, t.b_host_limit, t.a_descriptors,
           t.a_leaf, t.a_chains, t.a_spec_ok, t.a_spec_rej, t.a_run_ok,
           t.a_run_rej, t.a_host_limit, t.a_unattributed);
    fprintf(stderr,
            "controls %d/%d | B run %d/%d parity %d | A ran %d of %d "
            "(spec-parse ok %d, host-limit %d, unattributed %d)\n",
            t.controls_ok, t.controls_run, t.b_run_ok, t.b_targets,
            t.b_parity_ok, t.a_run_ok, t.a_chains, t.a_spec_ok,
            t.a_host_limit, t.a_unattributed);
    return 0;
}
